## CMakeLists.txt
```
# SPDX-License-Identifier: Apache-2.0

cmake_minimum_required(VERSION 3.20.0)

find_package(Zephyr REQUIRED HINTS $ENV{ZEPHYR_BASE})
project(my_two_leds)

target_sources(app PRIVATE src/main.c)
```

## prj.conf
```kconfig
CONFIG_GPIO=y
CONFIG_PRINTK=y
# enable to use thread names
CONFIG_THREAD_NAME=y
```

## src/main.c
```c
/*
 * Copyright (c) 2017 Linaro Limited
 *
 * SPDX-License-Identifier: Apache-2.0
 */

#include <zephyr/kernel.h>
#include <zephyr/device.h>
#include <zephyr/devicetree.h>
#include <zephyr/drivers/gpio.h>
#include <zephyr/sys/printk.h>
#include <zephyr/sys/__assert.h>
#include <zephyr/sys/mem_manage.h>
#include <string.h>



/* size of stack area used by each thread */
#define STACKSIZE 1024

/* scheduling priority used by each thread */
#define PRIORITY 7

#define LED0_NODE DT_ALIAS(led0)
#define LED1_NODE DT_ALIAS(led1)

#if !DT_NODE_HAS_STATUS(LED0_NODE, okay)
#error "Unsupported board: led0 devicetree alias is not defined"
#endif

#if !DT_NODE_HAS_STATUS(LED1_NODE, okay)
#error "Unsupported board: led1 devicetree alias is not defined"
#endif

// struct printk_data_t
// {
//     void *fifo_reserved; /* 1st word reserved for use by fifo */
//     uint32_t led;
//     uint32_t cnt;
// };

// #define PRINTK_DATA_SIZE sizeof(struct printk_data_t)
// K_FIFO_DEFINE_STATIC(printk_fifo); // 8 slots, auto-sized // 8 slots
// // K_FIFO_DEFINE_STATIC(printk_fifo);
// //K_FIFO_DEFINE(printk_fifo);

/* 1. Struct */
struct printk_data_t
{
    void *fifo_reserved; /* 1st word reserved for use by fifo */
    uint32_t led;
    uint32_t cnt;
};

/* 2. Static FIFO — NO size macro needed */
K_FIFO_DEFINE(printk_fifo); // 8 slots, auto-sized

struct led
{
    struct gpio_dt_spec spec;
    const char *gpio_pin_name;
};

static const struct led led0 = {
    .spec = GPIO_DT_SPEC_GET_OR(LED0_NODE, gpios, {0}),
    .gpio_pin_name = DT_PROP_OR(LED0_NODE, label, ""),
};

static const struct led led1 = {
    .spec = GPIO_DT_SPEC_GET_OR(LED1_NODE, gpios, {0}),
    .gpio_pin_name = DT_PROP_OR(LED1_NODE, label, ""),
};

void blink(const struct led *led, uint32_t sleep_ms, uint32_t id)
{
    const struct gpio_dt_spec *spec = &led->spec;
    int cnt = 0;
    int ret;

    if (!device_is_ready(spec->port))
    {
        printk("Error: %s device is not ready\n", spec->port->name);
        return;
    }

    ret = gpio_pin_configure_dt(spec, GPIO_OUTPUT);
    if (ret != 0)
    {
        printk("Error %d: failed to configure pin %d (LED '%s')\n",
               ret, spec->pin, led->gpio_pin_name);
        return;
    }

    while (1)
    {
        gpio_pin_set(spec->port, spec->pin, cnt % 2);

        struct printk_data_t tx_data = {.led = id, .cnt = cnt};

        size_t size = sizeof(struct printk_data_t);
        //char *mem_ptr = k_malloc(size);
        //__ASSERT_NO_MSG(mem_ptr != 0);

        //memcpy(mem_ptr, &tx_data, size);

        //k_fifo_put(&printk_fifo, mem_ptr);

        k_fifo_put(&printk_fifo, &tx_data);

        k_msleep(sleep_ms);
        cnt++;
    }
}

void blink0(void)
{
    blink(&led0, 100, 0);
}

void blink1(void)
{
    blink(&led1, 1000, 1);
}

void uart_out(void)
{
    while (1)
    {
        struct printk_data_t data;
        struct printk_data_t *rx_data = k_fifo_get(&printk_fifo,
                                                   K_FOREVER);
        if (rx_data)
        {
            memcpy(&data, rx_data, sizeof(data));
            printk("Toggled led%d; counter=%d\n", data.led, data.cnt);
        }

                                                   //printk("Toggled led%d; counter=%d\n",
        //       rx_data->led, rx_data->cnt);
       // k_free(rx_data);


    }
}

K_THREAD_DEFINE(blink0_id, STACKSIZE, blink0, NULL, NULL, NULL,
                PRIORITY, 0, 0);
K_THREAD_DEFINE(blink1_id, STACKSIZE, blink1, NULL, NULL, NULL,
                PRIORITY, 0, 0);
K_THREAD_DEFINE(uart_out_id, STACKSIZE, uart_out, NULL, NULL, NULL,
                PRIORITY, 0, 0);
```
